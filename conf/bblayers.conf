## conf/bblayers.conf
```bitbake
# POKY_BBLAYERS_CONF_VERSION is increased each time build/conf/bblayers.conf
# changes incompatibly
POKY_BBLAYERS_CONF_VERSION = "2"

BBPATH = "${TOPDIR}"
BBFILES ?= ""

BBLAYERS ?= " \
  /home/mirza/workspace/adu-pi/poky/meta \
  /home/mirza/workspace/adu-pi/poky/meta-poky \
  /home/mirza/workspace/adu-pi/poky/meta-yocto-bsp \
  /home/mirza/workspace/adu-pi/meta-openembedded/meta-oe \
  /home/mirza/workspace/adu-pi/meta-openembedded/meta-python \
  /home/mirza/workspace/adu-pi/meta-openembedded/meta-networking \
  /home/mirza/workspace/adu-pi/meta-openembedded/meta-multimedia \
  /home/mirza/workspace/adu-pi/meta-raspberrypi \
  /home/mirza/workspace/adu-pi/meta-swupdate \
  /home/mirza/workspace/adu-pi/meta-azure-device-update \
  "
```

## meta-adu-pi/conf/local.conf
```bitbake
CONF_VERSION = "1"

MACHINE = "raspberrypi3"

SDIMG_ROOTFS_TYPE = "ext4"
ENABLE_UART = "1"
RPI_USE_U_BOOT = "1"
PREFERRED_PROVIDER_virtual/bootloader = "u-boot"
DISTRO_FEATURES_append = " systemd virtualization"
VIRTUAL-RUNTIME_init_manager = "systemd"
DISTRO_FEATURES_BACKFILL_CONSIDERED = "sysvinit"
VIRTUAL-RUNTIME_initscripts = ""

IMAGE_INSTALL_append = " adu-agent-service"

# Import manifest file properties for Azure Device Update (no whitespace allowed)
ADU_SOFTWARE_PROVIDER = "Line-Studio"
ADU_SOFTWARE_NAME = "RaspberryPi3-adu"
ADU_SOFTWARE_VERSION = "0.0.0.1"
ADU_INSTALLED_CRITERIA = "0.0.0.1"

# Manufacturer and model will be written to the adu-config.txt file on the image and
# added to import manifest file. The config and manifest file need to have matching values
# for a device to be compatible with a pending update.
MANUFACTURER = "Line Studio"
MODEL = "RaspberryPi3-ls"

# Used to sign the .swu update image.
ADUC_PRIVATE_KEY = "###TOPDIR###/priv.pem"
ADUC_PRIVATE_KEY_PASSWORD = "###TOPDIR###/priv.pass"
```
